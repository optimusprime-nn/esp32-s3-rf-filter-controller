## main/Kconfig.projbuild
```kconfig
menu "RF controller fan"

    config RF_FAN_PWM_GPIO
        int "Fan PWM output GPIO"
        range 0 48
        default 1
        help
            Drives the fan's PWM input through a transistor. Avoid strapping pins,
            USB (GPIO19/20) and octal PSRAM (GPIO33 to GPIO37).

    config RF_FAN_PWM_INVERTED
        bool "Invert PWM output"
        default n
        help
            Off for a non-inverting 3.3 V to 5 V level shifter between the GPIO and
            the fan's PWM input, as on this board. Turn it on for an open-collector
            transistor driver instead, where a high GPIO pulls the PWM line low.

    config RF_FAN_PWM_FREQ_HZ
        int "PWM frequency (Hz)"
        range 1000 40000
        default 25000
        help
            4-wire PC fans expect 21 to 28 kHz.

    config RF_FAN_TACH_GPIO
        int "Fan tachometer input GPIO (-1 for none)"
        range -1 48
        default 9

    config RF_FAN_PULSES_PER_REV
        int "Tachometer pulses per revolution"
        range 1 8
        default 2

    config RF_FAN_DEFAULT_PERCENT
        int "Fan speed before one is saved (percent)"
        range 0 100
        default 100

endmenu

menu "RF controller temperature sensors"

    config RF_I2C_SDA_GPIO
        int "I2C SDA GPIO"
        range 0 48
        default 10

    config RF_I2C_SCL_GPIO
        int "I2C SCL GPIO"
        range 0 48
        default 11

    config RF_TEMP_I2C_ADDRESSES
        string "LM75-family sensor addresses"
        default "0x48"
        help
            Comma-separated 7-bit addresses of LM75, TMP75, TMP102 or PCT2075
            sensors, up to eight. Leave empty for none. Only list addresses that
            hold one of these sensors: another chip at the same address would be
            read as a temperature.

endmenu

menu "RF controller weather station receiver"

    config RF_WEATHER_ENABLE
        bool "Receive a VEVOR 7-in-1 weather station with a CC1101"
        default y
        help
            Receives the outdoor sensor of a VEVOR 7-in-1 weather station
            (YT60231, YT60233, YT60234) through a CC1101 on SPI. Without a
            CC1101 fitted the firmware reports the receiver as missing.

    config RF_WEATHER_FREQ_KHZ
        int "Receive frequency (kHz)"
        depends on RF_WEATHER_ENABLE
        range 779000 928000
        default 915000
        help
            915000 for US models (YT60233, YT60234), 868300 for EU models
            (YT60231). Use a CC1101 module built for this band.

    config RF_WEATHER_SENSOR_ID
        int "Station ID to accept (-1 for any)"
        depends on RF_WEATHER_ENABLE
        range -1 65535
        default -1
        help
            The outdoor sensor's 16-bit ID, shown by the console's "weather"
            command and the API. Set it to ignore neighbours' stations. The ID
            may change when the sensor's batteries are replaced.

    config RF_WEATHER_INVERT
        bool "Invert the FSK data"
        depends on RF_WEATHER_ENABLE
        default n
        help
            Turn this on only if the station is close by but every packet is
            missed: some receivers see the two FSK tones the other way round.

    config RF_WEATHER_SCK_GPIO
        int "CC1101 SCK GPIO"
        depends on RF_WEATHER_ENABLE
        range 0 48
        default 12

    config RF_WEATHER_MOSI_GPIO
        int "CC1101 MOSI (SI) GPIO"
        depends on RF_WEATHER_ENABLE
        range 0 48
        default 13

    config RF_WEATHER_MISO_GPIO
        int "CC1101 MISO (SO) GPIO"
        depends on RF_WEATHER_ENABLE
        range 0 48
        default 14

    config RF_WEATHER_CS_GPIO
        int "CC1101 CSn GPIO"
        depends on RF_WEATHER_ENABLE
        range 0 48
        default 15

    config RF_WEATHER_GDO0_GPIO
        int "CC1101 GDO0 GPIO"
        depends on RF_WEATHER_ENABLE
        range 0 48
        default 16

    config RF_WEATHER_FEED_ENABLE
        bool "TCP feed of readings for other devices"
        depends on RF_WEATHER_ENABLE
        default y
        help
            Listens on a TCP port and sends every reading from the accepted station
            as one line of JSON, for displays such as the ESP32-P4 ADS-B display.
            It holds weather data only, needs no client certificate and accepts no
            commands. Up to four clients at once. Turn it off if weather readings
            shouldn't be readable by anything on the LAN.

    config RF_WEATHER_FEED_PORT
        int "Weather feed TCP port"
        depends on RF_WEATHER_FEED_ENABLE
        range 1 65535
        default 30090

endmenu

menu "RF controller SDR board resets"

    config RF_SDR_SOFT_RESET_GPIO
        int "Soft reset GPIO (to a Radxa GPIO)"
        range 0 48
        default 4
        help
            Open-drain, active low. Pulled low to ask the Radxa to reboot cleanly.
            The Radxa side needs a pull-up and a gpio-shutdown key or service
            that reboots on a falling edge.

    config RF_SDR_SOFT_RESET_PULSE_MS
        int "Soft reset pulse length (ms)"
        range 50 10000
        default 1000

    config RF_SDR_RELAY_GPIO
        int "Hard reset relay GPIO"
        range 0 48
        default 5
        help
            Active high. Energises the relay whose normally-closed contact carries
            the Radxa's power, so power is cut only while this output is high.
            Fit a pull-down on the relay driver's input: the pin floats while this
            controller resets.

    config RF_SDR_POWER_OFF_MS
        int "Hard reset power-off time (ms)"
        range 500 60000
        default 5000
        help
            How long the Radxa stays unpowered before the relay releases.

    config RF_SDR_COOLDOWN_MS
        int "Cooldown after an SDR reset (ms)"
        range 0 600000
        default 10000
        help
            New reset requests are refused for this long after one ends.

endmenu

menu "RF controller firmware updates"

    config RF_OTA_SOAK_SECONDS
        int "Seconds before a new image confirms itself"
        range 30 3600
        default 300
        help
            A new image boots pending verification. If HTTPS management is up
            after this long, the image is marked valid; otherwise it is rolled
            back. A crash or reset before then also rolls it back. Matches the
            time server's 300 s.

endmenu
```
